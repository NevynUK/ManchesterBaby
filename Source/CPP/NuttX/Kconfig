## Source/CPP/NuttX/Kconfig
```kconfig
#
# For a description of the syntax of this configuration file,
# see the file kconfig-language.txt in the NuttX tools repository.
#

config EXAMPLES_SSEM
	tristate "SSEM example"
	default n
	depends on HAVE_CXX
	---help---
		Enable the SSEM application

if EXAMPLES_SSEM

config EXAMPLES_SSEM_PROGNAME
		string "Program name"
		default "ssem"
		---help---
				This is the name of the program that will be used when the NSH ELF
				program is installed.

config EXAMPLES_SSEM_PRIORITY
		int "SSEM task priority"
		default 100

config EXAMPLES_SSEM_STACKSIZE
		int "SSEM stack size"
		default DEFAULT_TASK_STACKSIZE

endif
```

## Source/Tab5SSEM/tests/rtc/sdkconfig.defaults
```kconfig
# Rtc test app — minimal config for ESP32-P4 on Tab5 hardware.
CONFIG_IDF_TARGET="esp32p4"
CONFIG_ESPTOOLPY_FLASHSIZE_16MB=y

# Chip revision: the Tab5 uses ESP32-P4 silicon revision 0.x/1.x (reported by
# esptool as 'v1.0').  ESP32P4_SELECTS_REV_LESS_V3 must be set first to unlock
# the low-revision choice set; without it Kconfig only offers {300, 301}.
CONFIG_ESP32P4_SELECTS_REV_LESS_V3=y
CONFIG_ESP32P4_REV_MIN_1=y

# Disable Task Watchdog Timer so long vTaskDelay calls in the tests (e.g. the
# 7-second minute-boundary test) do not starve the IDLE task.
CONFIG_ESP_TASK_WDT_EN=n

# PSRAM — ESP32-P4 uses HEX PSRAM (not OCT); 200MHz required for MIPI-DSI framebuffer DMA
# CONFIG_SPIRAM_SPEED_200M depends on IDF_EXPERIMENTAL_FEATURES — both must be set together
CONFIG_IDF_EXPERIMENTAL_FEATURES=y
CONFIG_SPIRAM=y
CONFIG_SPIRAM_SPEED_200M=y
```

## Source/Tab5SSEM/tests/sdcard/sdkconfig.defaults
```kconfig
# SDCard test app — minimal config for ESP32-P4 on Tab5 hardware.
# No PSRAM is needed for this test project.
CONFIG_IDF_TARGET="esp32p4"

# Chip revision: the Tab5 uses ESP32-P4 silicon revision 0.x/1.x (reported by
# esptool as 'v1.0').  ESP32P4_SELECTS_REV_LESS_V3 must be set first to unlock
# the low-revision choice set; without it Kconfig only offers {300, 301}.
CONFIG_ESP32P4_SELECTS_REV_LESS_V3=y
CONFIG_ESP32P4_REV_MIN_1=y

# Enable long filename support in FATFS.
CONFIG_FATFS_LFN_HEAP=y

# Disable Task Watchdog Timer for the test application.
# unity_run_menu() blocks the main task on UART input, which would otherwise
# starve the IDLE task and trigger the TWDT within the default 5-second window.
CONFIG_ESP_TASK_WDT_EN=n
```
